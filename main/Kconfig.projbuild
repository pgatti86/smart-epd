## main/Kconfig.projbuild
```kconfig
menu "SMART-EPD config"

config SNTP_SERVER
    string "SNTP Server"
	default "pool.ntp.org"

config OTA_SERVER
    string "OTA Server"
	default "https://mydomain.com/smart-epd.bin"    

config DHT_GPIO
    int "DHT GPIO"
    default 4

config BUTTON_GPIO
    int "BUTTON GPIO"
    range 0 34
    default 0    

config MAX_REWRITE_COUNT
    int "Max number of screen rewrite before full clean"
    default 3600
    help
        Eink display needs a full refresh after some write cycles. The Eink display is update once a second if needed.
	    			
endmenu
```
